## brvendor/Config.in
```kconfig
source "$BR2_EXTERNAL_MINIBASE_PATH/package/kilo/Config.in"
source "$BR2_EXTERNAL_MINIBASE_PATH/package/xorg-server-wl/Config.in"

if BR2_PACKAGE_XORG_SERVER_WL

source "$BR2_EXTERNAL_MINIBASE_PATH/package/xf86-input-evdev/Config.in"
source "$BR2_EXTERNAL_MINIBASE_PATH/package/xf86-input-libinput/Config.in"
source "$BR2_EXTERNAL_MINIBASE_PATH/package/xf86-video-intel/Config.in"

endif
```

## brvendor/configs/minibase_defconfig
```kconfig
BR2_x86_64=y
BR2_TOOLCHAIN_BUILDROOT_MUSL=y
BR2_EXTRA_GCC_CONFIG_OPTIONS="--disable-gnu-indirect-function"
BR2_TOOLCHAIN_BUILDROOT_CXX=y
BR2_INIT_NONE=y
BR2_ROOTFS_DEVICE_CREATION_DYNAMIC_EUDEV=y
# BR2_TARGET_ENABLE_ROOT_LOGIN is not set
# BR2_TARGET_GENERIC_GETTY is not set
# BR2_TARGET_GENERIC_REMOUNT_ROOTFS_RW is not set
BR2_LINUX_KERNEL=y
BR2_LINUX_KERNEL_USE_CUSTOM_CONFIG=y
BR2_LINUX_KERNEL_CUSTOM_CONFIG_FILE="$(BR2_EXTERNAL_MINIBASE_PATH)/board/minibase/linux.config"
BR2_PACKAGE_MESA3D=y
BR2_PACKAGE_MESA3D_GALLIUM_DRIVER_SWRAST=y
BR2_PACKAGE_MESA3D_GALLIUM_DRIVER_VIRGL=y
BR2_PACKAGE_MESA3D_DRI_DRIVER_SWRAST=y
BR2_PACKAGE_MESA3D_DRI_DRIVER_I965=y
BR2_PACKAGE_MESA3D_OPENGL_ES=y
BR2_PACKAGE_WESTON=y
BR2_PACKAGE_WESTON_DRM=y
BR2_PACKAGE_WESTON_DEMO_CLIENTS=y
BR2_PACKAGE_LINUX_FIRMWARE=y
BR2_PACKAGE_LINUX_FIRMWARE_IWLWIFI_6000G2A=y
BR2_PACKAGE_LINUX_FIRMWARE_IWLWIFI_6000G2B=y
BR2_PACKAGE_LINUX_FIRMWARE_IWLWIFI_7260=y
BR2_PACKAGE_LINUX_FIRMWARE_IWLWIFI_7265D=y
BR2_PACKAGE_LINUX_FIRMWARE_IWLWIFI_8000C=y
BR2_PACKAGE_LINUX_FIRMWARE_IWLWIFI_8265=y
# BR2_PACKAGE_EUDEV_ENABLE_HWDB is not set
BR2_PACKAGE_LIBDRM_VMWGFX=y
BR2_PACKAGE_GNU_EFI=y
# BR2_TARGET_ROOTFS_TAR is not set
```

## brvendor/package/fluxbox-patched/Config.in
```kconfig
config BR2_PACKAGE_FLUXBOX_PATCHED
	bool "fluxbox-patched"
	depends on BR2_PACKAGE_XORG7
	depends on BR2_INSTALL_LIBSTDCPP
	depends on BR2_USE_MMU # fork()
	select BR2_PACKAGE_XLIB_LIBX11
	# Runtime dependency, needed by startup script
	select BR2_PACKAGE_XAPP_XMODMAP
	help
	  The Fluxbox lightweight window manager for X
	  (patched to work with minibase)

	  http://fluxbox.org

comment "fluxbox needs a toolchain w/ C++"
	depends on BR2_USE_MMU
	depends on BR2_PACKAGE_XORG7 && !BR2_INSTALL_LIBSTDCPP
```

## brvendor/package/kilo/Config.in
```kconfig
config BR2_PACKAGE_KILO
	bool "kilo"
	help
	  Small text editor

	  https://github.com/antirez/kilo
```

## brvendor/package/rxvt-unicode/Config.in
```kconfig
config BR2_PACKAGE_RXVT_UNICODE
	bool "rxvt-unicode"
	depends on BR2_PACKAGE_XORG7
	depends on BR2_USE_MMU # fork()
	help
	  Terminal emulator with unicode support.

	  http://software.schmorp.de/pkg/rxvt-unicode.html
```

## brvendor/package/xorg-server-wl/Config.in
```kconfig
config BR2_PACKAGE_XORG_SERVER_WL
	bool "xorg-server-wl"
	depends on BR2_USE_MMU # fork()
	# xserver uses inb/outb on arm, which aren't available with musl
	depends on !(BR2_arm && BR2_TOOLCHAIN_USES_MUSL)
	# We need a SHA1 implementation. If either openssl or
	# libgcrypt are already part of the build, we'll use one of
	# them, otherwise, use the small libsha1 library.
	select BR2_PACKAGE_LIBSHA1 if (!BR2_PACKAGE_OPENSSL && !BR2_PACKAGE_LIBGCRYPT)
	select BR2_PACKAGE_MCOOKIE
	select BR2_PACKAGE_PIXMAN
	select BR2_PACKAGE_XFONT_FONT_ALIAS
	select BR2_PACKAGE_XFONT_FONT_MISC_MISC
	select BR2_PACKAGE_XFONT_FONT_CURSOR_MISC
	select BR2_PACKAGE_XLIB_LIBX11
	select BR2_PACKAGE_XLIB_LIBXAU
	select BR2_PACKAGE_XLIB_LIBXCURSOR
	select BR2_PACKAGE_XLIB_LIBXDAMAGE
	select BR2_PACKAGE_XLIB_LIBXDMCP
	select BR2_PACKAGE_XLIB_LIBXEXT
	select BR2_PACKAGE_XLIB_LIBXFIXES
	select BR2_PACKAGE_XLIB_LIBXFT
	select BR2_PACKAGE_XLIB_LIBXI
	select BR2_PACKAGE_XLIB_LIBXINERAMA
	select BR2_PACKAGE_XLIB_LIBXRANDR
	select BR2_PACKAGE_XLIB_LIBXRENDER
	select BR2_PACKAGE_XLIB_LIBXRES
	select BR2_PACKAGE_XLIB_LIBXXF86VM
	select BR2_PACKAGE_XLIB_LIBXKBFILE
	select BR2_PACKAGE_XLIB_XTRANS
	select BR2_PACKAGE_XDATA_XBITMAPS
	select BR2_PACKAGE_XPROTO_BIGREQSPROTO
	select BR2_PACKAGE_XPROTO_COMPOSITEPROTO
	select BR2_PACKAGE_XPROTO_DAMAGEPROTO
	select BR2_PACKAGE_XPROTO_FIXESPROTO
	select BR2_PACKAGE_XPROTO_FONTSPROTO
	select BR2_PACKAGE_XPROTO_GLPROTO
	select BR2_PACKAGE_XPROTO_INPUTPROTO
	select BR2_PACKAGE_XPROTO_KBPROTO
	select BR2_PACKAGE_XPROTO_RANDRPROTO
	select BR2_PACKAGE_XPROTO_RENDERPROTO
	select BR2_PACKAGE_XPROTO_RESOURCEPROTO
	select BR2_PACKAGE_XPROTO_VIDEOPROTO
	select BR2_PACKAGE_XPROTO_XCMISCPROTO
	select BR2_PACKAGE_XPROTO_XEXTPROTO
	select BR2_PACKAGE_XPROTO_XF86BIGFONTPROTO
	select BR2_PACKAGE_XPROTO_XF86DGAPROTO
	select BR2_PACKAGE_XPROTO_XF86VIDMODEPROTO
	select BR2_PACKAGE_XPROTO_XPROTO
	select BR2_PACKAGE_XUTIL_UTIL_MACROS
	select BR2_PACKAGE_XKEYBOARD_CONFIG
	select BR2_PACKAGE_XPROTO_DRI2PROTO
	select BR2_PACKAGE_XLIB_LIBXFONT2
	select BR2_PACKAGE_XLIB_LIBXCOMPOSITE
	select BR2_PACKAGE_XPROTO_PRESENTPROTO
	select BR2_PACKAGE_LIBDRM
	select BR2_PACKAGE_LIBPCIACCESS
	select BR2_PACKAGE_XLIB_LIBXSHMFENCE if BR2_TOOLCHAIN_HAS_SYNC_4
	help
	  X.Org X server with weston-launch patch

	  http://xorg.freedesktop.org
```
